## arch/arm64/hotplug/Kconfig
```kconfig
config ALUCARD_HOTPLUG
	bool "Enable alucard-hotplug cpu hotplug driver"
 	default n
 	help
 	  Generic Alucard-hotplug cpu hotplug driver for ARM SOCs

config LAZYPLUG
	bool "Conservative hotplugging for generic devices"
	default n
	help
	  This enables the conservative hotplugging, lazyplug by arter97
	  based on intelli_plug. Refer to the comments for more info.
```

## drivers/platform/zte/Kconfig
```kconfig
# ZTE configuration options

config MACH_ZTE
	bool "ZTE device"
	depends on ARCH_MSM
	help
	  Support for ZTE products

config MACH_ZTE_MSM8996
	bool "ZTE MSM8996"
	depends on ARCH_MSM8996
	select MACH_ZTE
	help
	  Support for MSM8996 ZTE variants

menu "ZTE board selection"

config MACH_ZTE_AILSA_II
	bool "Ailsa board"
	select MACH_ZTE_MSM8996
	help
	  Support for Axon 7 (ailsa)

endmenu
```
